AUTOSAR XML (schema 00051)
package /control_CommunicationCluster
  ethernet cluster ComCluster
    ethernet physical channel PhysicalChannel
      network endpoint NetworkEndpoint: network-endpoint-addresses=ipv-4-configuration=ipv-4-address=127.0.0.1
package /control_Deployments
  dds service interface deployment DdsDeployment_RequiredPort: transport-protocols=TCP
    dds event deployment Deployment_Lkas: event=Lkas, topic-name=Lkas, transport-protocols=TCP
    dds event deployment Deployment_Aeb: event=Aeb, topic-name=Aeb, transport-protocols=TCP
  someip service interface deployment SomeipDeployment_RequiredPort
    someip event deployment Deployment_Lkas: event=Lkas, event-id=63083
    someip event deployment Deployment_Aeb: event=Aeb, event-id=5608
    someip event group EventGroup_RequiredPort: event-group-id=63603, event=[Deployment_Lkas, Deployment_Aeb]
package /control_MachineDesign
  machine design MachineDesign
    ethernet communication connector CommunicationConnector: unicast-network-endpoint=NetworkEndpoint
package /control_ServiceInstToMachineMap
  dds service instance to machine mapping DdsServiceInstToMachineMap_DdsSI_RequiredPort: communication-connector=CommunicationConnector, service-instance=DdsSI_RequiredPort
  someip service instance to machine mapping SomeIpServiceInstToMachineMap_SomeipSI_RequiredPort: communication-connector=CommunicationConnector, service-instance=SomeipSI_RequiredPort
  someip service instance to machine mapping SomeIpServiceInstToMachineMap_SomeipSI_RequiredPort_SomeipSI_RequiredPort: communication-connector=CommunicationConnector, service-instance=SomeipSI_RequiredPort
package /control_ServiceInstanceToPortMappings
  service instance to port prototype mapping Mapping_RequiredPort: port-prototype=control.RequiredPort, process-design=DefaultProcessDesign, service-instance=SomeipSI_RequiredPort
package /control_ServiceInstances
  dds required service instance DdsSI_RequiredPort: service-interface-deployment=DdsDeployment_RequiredPort, domain-id=0, event-qos-propss=[{qos-profile=RELIABLE, event=Deployment_Lkas}, {qos-profile=RELIABLE, event=Deployment_Aeb}], required-service-instance-id=1
  required someip service instance SomeipSI_RequiredPort: service-interface-deployment=SomeipDeployment_RequiredPort, required-service-instance-id=1
    someip required event group RequiredEventGroup_RequiredPort: event-group=EventGroup_RequiredPort
