AUTOSAR XML (schema 00051)
package /Components
  adaptive application sw component type control
    require port RequiredPort: required-com-specs=[data-element=Lkas, data-element=Aeb], required-interface=RequiredInterface
