AUTOSAR XML (schema 00051)
package /Interfaces
  service interface RequiredInterface
    events:
      data Lkas: category=VALUE, sw-calibration-access=READ-ONLY, sw-impl-policy=QUEUED, type=double
      data Aeb: category=VALUE, sw-calibration-access=READ-ONLY, sw-impl-policy=QUEUED, type=double
