AUTOSAR XML (schema 00051)
package /Components
  adaptive application sw component type aeb
    provide port ProvidedPort: provided-com-specs=[data-element=Brake, data-element=Steering], provided-interface=ProvidedInterface
