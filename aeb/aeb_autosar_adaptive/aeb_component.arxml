AUTOSAR XML (schema 00051)
package /Components
  adaptive application sw component type aeb
    provide port ProvidedPort: queued-sender-com-spec=data-element=Brake, provided-interface=ProvidedInterface
