AUTOSAR XML (schema 00051)
package /ModeDeclarationGroups
  mode declaration group ProcessStateMachine: initial-mode=Idle
    5 x mode:
      Idle: value=1
      Starting: value=2
      Running: value=3
      Terminating: value=4
      Terminated: value=5
package /aeb_Executable
  executable aeb: build-type=BUILD-TYPE-DEBUG
    root sw component prototype aeb_RootSwComponentPrototype: application-type=aeb
package /aeb_FunctionGroupSet
  function group set DefaultFunctionGroupSet
    function-groups:
      mode declaration group prototype MachineFG: sw-calibration-access=READ-ONLY, type=MachineFG
package /aeb_ProcessDesigns
  process design DefaultProcessDesign: executable=aeb
package /aeb_ProcessToMachineMappingSet
  process to machine mapping set ProcessToMachineMappingSet
    process to machine mapping DefaultMapping: machine=Host, process=DefaultInstance
package /aeb_Processes
  process DefaultInstance: design=DefaultProcessDesign, executable=aeb, state-dependent-startup-config{function-group-state=MachineFG.Running, resource-group=DefaultResourceGroup, startup-config=StartupConfigRR}
    process state machine ProcessStateMachine_ModeDeclarationGroupElement: sw-calibration-access=READ-ONLY, type=ProcessStateMachine
package /aeb_StartupConfigs
  startup config StartupConfigRR: process-arguments=[-s, ServiceInstanceManifest.json, -e, ExecutionManifest.json], scheduling-policy=SCHEDULING-POLICY-ROUND-ROBIN, scheduling-priority=32
  startup config StartupConfigFifo: process-arguments=[-s, ServiceInstanceManifest.json, -e, ExecutionManifest.json], scheduling-policy=SCHEDULING-POLICY-FIFO, scheduling-priority=32
  startup config StartupConfigOther: process-arguments=[-s, ServiceInstanceManifest.json, -e, ExecutionManifest.json], scheduling-policy=SCHEDULING-POLICY-OTHER, scheduling-priority=32
