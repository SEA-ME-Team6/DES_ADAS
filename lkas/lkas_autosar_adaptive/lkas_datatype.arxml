AUTOSAR XML (schema 00051)
package /AUTOSAR/StdTypes
  std cpp implementation data type double: category=VALUE
