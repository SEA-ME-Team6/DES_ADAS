AUTOSAR XML (schema 00051)
package /lkas_CommunicationCluster
  ethernet cluster ComCluster
    ethernet physical channel PhysicalChannel
      network endpoint NetworkEndpoint: network-endpoint-addresses=ipv-4-configuration=ipv-4-address=127.0.0.1
package /lkas_Deployments
  someip service interface deployment SomeipDeployment_ProvidedPort
    someip event deployment Deployment_Distance_error: event=Distance_error, event-id=65364
    someip event group EventGroup_ProvidedPort: event-group-id=65364, event=Deployment_Distance_error
package /lkas_MachineDesign
  machine design MachineDesign
    ethernet communication connector CommunicationConnector: unicast-network-endpoint=NetworkEndpoint
package /lkas_ServiceInstToMachineMap
  someip service instance to machine mapping SomeIpServiceInstToMachineMap_SomeipSI_ProvidedPort: communication-connector=CommunicationConnector, service-instance=SomeipSI_ProvidedPort
  someip service instance to machine mapping SomeIpServiceInstToMachineMap_SomeipSI_ProvidedPort_SomeipSI_ProvidedPort: communication-connector=CommunicationConnector, service-instance=SomeipSI_ProvidedPort
package /lkas_ServiceInstanceToPortMappings
  service instance to port prototype mapping Mapping_ProvidedPort: port-prototype=lkas.ProvidedPort, process-design=DefaultProcessDesign, service-instance=SomeipSI_ProvidedPort
package /lkas_ServiceInstances
  provided someip service instance SomeipSI_ProvidedPort: service-interface-deployment=SomeipDeployment_ProvidedPort, service-instance-id=1
    someip provided event group ProvidedEventGroup_ProvidedPort: event-group=EventGroup_ProvidedPort
