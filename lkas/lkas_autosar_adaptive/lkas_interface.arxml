AUTOSAR XML (schema 00051)
package /Interfaces
  service interface ProvidedInterface
    events:
      data Distance_error: category=VALUE, sw-calibration-access=READ-ONLY, sw-impl-policy=QUEUED, type=double
      data Throttle: category=VALUE, sw-calibration-access=READ-ONLY, sw-impl-policy=QUEUED, type=double
