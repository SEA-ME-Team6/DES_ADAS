AUTOSAR XML (schema 00051)
package /Components
  adaptive application sw component type lkas
    provide port ProvidedPort: provided-com-specs=[data-element=Distance_error, data-element=Throttle], provided-interface=ProvidedInterface
