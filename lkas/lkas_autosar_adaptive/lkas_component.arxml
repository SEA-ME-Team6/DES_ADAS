AUTOSAR XML (schema 00051)
package /Components
  adaptive application sw component type lkas
    provide port ProvidedPort: queued-sender-com-spec=data-element=Distance_error, provided-interface=ProvidedInterface
